## conf/layer.conf
```bitbake
# We have a conf and classes directory, add to BBPATH
BBPATH .= ":${LAYERDIR}"

# We have recipes-* directories, add to BBFILES
BBFILES += "${LAYERDIR}/recipes-*/*/*.bb \
            ${LAYERDIR}/recipes-*/*/*.bbappend"

BBFILE_COLLECTIONS += "meta-bssr-rfsos"
BBFILE_PATTERN_meta-bssr-rfsos = "^${LAYERDIR}/"
BBFILE_PRIORITY_meta-bssr-rfsos = "6"

LAYERDEPENDS_meta-bssr-rfsos = "core"
LAYERSERIES_COMPAT_meta-bssr-rfsos = "scarthgap"

include conf/machine/apalis-imx8-extra.conf
```

## conf/machine/apalis-imx8-extra.conf
```bitbake
KERNEL_DEVICETREE:append = " freescale/bssr-devicetree.dtb"
TEZI_EXTERNAL_KERNEL_DEVICETREE_BOOT = "" 
```
